## Kconfig
```kconfig
choice PROSPECTOR_STATUS_SCREEN_LAYOUT
    prompt "Status screen layout"
    default PROSPECTOR_STATUS_SCREEN_DEFAULT

config PROSPECTOR_STATUS_SCREEN_DEFAULT
    bool "Default layout"
    help
        Standard Prospector status screen

config PROSPECTOR_STATUS_SCREEN_ROUNDED_GRID
    bool "Rounded grid layout"
    help
        Colorful grid layout with rounded widgets

config PROSPECTOR_STATUS_SCREEN_WIND_MAP
    bool "Wind map layout"
    help
        Status screen centered around wind map style WPM visualization

config PROSPECTOR_STATUS_SCREEN_OPERATOR
    bool "Operator layout"
    help
        HUD-style status screen with WPM bar graph, modifiers, and profile slots

endchoice

config PROSPECTOR_ROTATE_DISPLAY_180
    bool "Rotate the display 180 degrees"
    default n

config PROSPECTOR_SHOW_MODIFIERS
    bool "Display modifier key indicators (Cmd, Opt, Ctrl, Shift)"
    default y

config PROSPECTOR_SHOW_INACTIVE_MODIFIERS
    bool "Show inactive modifier indicators (dim when not pressed)"
    default y
    depends on PROSPECTOR_SHOW_MODIFIERS
    help
      When enabled, inactive modifiers are shown with a dim color.
      When disabled, inactive modifiers are hidden completely.
      Only affects default and wind_map layouts.

config PROSPECTOR_USE_AMBIENT_LIGHT_SENSOR
    bool "Use ambient light sensor for auto brightness"
    default y

config PROSPECTOR_FIXED_BRIGHTNESS
    int "Fixed display brightness"
    default 50
    range 1 100
    depends on !PROSPECTOR_USE_AMBIENT_LIGHT_SENSOR
```

## boards/shields/prospector_adapter/Kconfig.defconfig
```kconfig
if SHIELD_PROSPECTOR_ADAPTER

config ZMK_SPLIT_BLE_CENTRAL_BATTERY_LEVEL_FETCHING
    default y

config ZMK_DISPLAY
   default y

choice ZMK_DISPLAY_STATUS_SCREEN
    default ZMK_DISPLAY_STATUS_SCREEN_CUSTOM
endchoice

rsource "src/layouts/*/Kconfig.defconfig"

choice ZMK_DISPLAY_WORK_QUEUE
    default ZMK_DISPLAY_WORK_QUEUE_DEDICATED
endchoice

choice ST7789V_PIXEL_FORMAT
	default ST7789V_RGB565
endchoice

config LV_Z_VDB_SIZE
    default 50

config LV_Z_DOUBLE_VDB
    default y

config LV_Z_FLUSH_THREAD
    default y

config LV_Z_MEM_POOL_SIZE
    default 16384

config LV_DPI_DEF
    default 261

config LV_Z_BITS_PER_PIXEL
	default 16

choice LV_COLOR_DEPTH
	default LV_COLOR_DEPTH_16
endchoice

config LV_COLOR_16_SWAP
	default y

choice LV_FONT_DEFAULT
    default LV_FONT_DEFAULT_MONTSERRAT_20
endchoice

config PWM
    default y

config LED
    default y

config PROSPECTOR_USE_AMBIENT_LIGHT_SENSOR
    select SENSOR
    select APDS9960

endif
```

## boards/shields/prospector_adapter/boards/nrf52840dk_nrf52840.conf
```kconfig
CONFIG_PROSPECTOR_USE_AMBIENT_LIGHT_SENSOR=n
CONFIG_PROSPECTOR_FIXED_BRIGHTNESS=50
CONFIG_ZMK_RTT_LOGGING=y
CONFIG_ZMK_DISPLAY_DEDICATED_THREAD_STACK_SIZE=4096
CONFIG_ZMK_BLE_THREAD_STACK_SIZE=2048
CONFIG_MAIN_STACK_SIZE=2048
CONFIG_LV_DPI_DEF=190
# CONFIG_PROSPECTOR_MINIMAL=y
```

## boards/shields/prospector_adapter/src/layouts/classic/Kconfig.defconfig
```kconfig
if PROSPECTOR_STATUS_SCREEN_CLASSIC

config ZMK_DISPLAY_STATUS_SCREEN_CUSTOM
    select LV_USE_LABEL
    select LV_USE_BAR
    select LV_USE_FLEX
    select LV_USE_ROLLER
    select LV_COLOR_SCREEN_TRANSP

endif
```

## boards/shields/prospector_adapter/src/layouts/field/Kconfig.defconfig
```kconfig
if PROSPECTOR_STATUS_SCREEN_FIELD

config ZMK_DISPLAY_STATUS_SCREEN_CUSTOM
    select LV_USE_LABEL
    select LV_COLOR_SCREEN_TRANSP
    select ZMK_WPM

config PROSPECTOR_ANIMATION_WPM_REFERENCE
    int "WPM value at which animation reaches max speed"
    default 70
    range 30 300

config PROSPECTOR_ANIMATION_INTENSITY_DECAY_SEC
    int "Time in seconds for lines to fade out after typing stops"
    default 30
    range 5 120
    help
      Controls how quickly lines fade out (opacity) after you stop typing.
      Shorter values = faster fade, longer values = lines linger more.
      Animation freezes at 10% of this time.

config PROSPECTOR_ANIMATION_FLOW_DECAY_SEC
    int "Time in seconds for line directions and length to settle after typing stops"
    default 300
    range 30 600
    help
      Controls how long lines maintain their direction and length.
      Lines gradually return to idle angle and shrink over this period.
      Longer values = more persistent flowing and length effect.

endif
```

## boards/shields/prospector_adapter/src/layouts/operator/Kconfig.defconfig
```kconfig
if PROSPECTOR_STATUS_SCREEN_OPERATOR

config ZMK_DISPLAY_STATUS_SCREEN_CUSTOM
    select LV_USE_LABEL
    select LV_USE_FLEX
    select LV_USE_ARC
    select LV_USE_BAR
    select LV_COLOR_SCREEN_TRANSP

config ZMK_WPM
    default y

config LV_Z_MEM_POOL_SIZE
    default 20000

endif
```

## boards/shields/prospector_adapter/src/layouts/radii/Kconfig.defconfig
```kconfig
if PROSPECTOR_STATUS_SCREEN_RADII

config ZMK_DISPLAY_STATUS_SCREEN_CUSTOM
    select LV_USE_LABEL
    select LV_USE_FLEX
    select LV_USE_ARC
    select LV_USE_SPINNER
    select LV_USE_CANVAS
    select LV_USE_IMAGE
    select LV_COLOR_SCREEN_TRANSP

endif
```

## boards/shields/prospector_adapter/src/layouts/rounded_grid/Kconfig.defconfig
```kconfig
if PROSPECTOR_STATUS_SCREEN_ROUNDED_GRID

config ZMK_DISPLAY_STATUS_SCREEN_CUSTOM
    select LV_USE_LABEL
    select LV_USE_FLEX
    select LV_USE_CANVAS
    select LV_USE_ARC
    select LV_USE_SPINNER
    select LV_COLOR_SCREEN_TRANSP

endif
```

## config/west.yml
```yaml
manifest:
  remotes:
    - name: zmkfirmware
      url-base: https://github.com/zmkfirmware
  projects:
    - name: zmk
      remote: zmkfirmware
      revision: main
      import: app/west.yml
  self:
    path: config

manifest:
  remotes:
    - name: zmkfirmware
      url-base: https://github.com/zmkfirmware
    - name: carrefinho                            # <--- add this
      url-base: https://github.com/carrefinho     # <--- and this
  projects:
    - name: zmk
      remote: zmkfirmware
      revision: main
      import: app/west.yml
    - name: prospector-zmk-module                 # <--- and these
      remote: carrefinho                          # <---
      revision: main                              # <---
  self:
    path: config
```

## dts/bindings/zmk,prospector-theme.yaml
```yaml
description: Prospector display theme

compatible: "zmk,prospector-theme"

properties:
  left-panel-bg:
    type: int
    required: false
  mod-panel-bg:
    type: int
    required: false
  battery-panel-bg:
    type: int
    required: false
  arc-bg:
    type: int
    required: false
  arc-indicator:
    type: int
    required: false
  layer-wheel-color:
    type: int
    required: false
  layer-text-color:
    type: int
    required: false
  mod-active-color:
    type: int
    required: false
  mod-inactive-color:
    type: int
    required: false
```
